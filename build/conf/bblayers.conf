## build/conf/bblayers.conf
```bitbake
# LAYER_CONF_VERSION is increased each time build/conf/bblayers.conf
# changes incompatibly
LCONF_VERSION = "6"

BBPATH = "${TOPDIR}"
BBFILES ?= ""

# This bblayers.conf file includes the meta-tlk layer.
# The images included in this BSP are built with meta-tlk (time limited kernel).
# This will cause the image to reboot after a period of time. To remove
# this functionality, you will want to build without the meta-tlk enabled.
BBLAYERS ?= " \
  /home/jenia/poky-jethro/meta \
  /home/jenia/poky-jethro/meta-yocto \
  /home/jenia/poky-jethro/meta-yocto-bsp \
  /home/jenia/poky-jethro/meta-intel \
  /home/jenia/poky-jethro/meta-intel/meta-isg/meta-valleyisland \
  /home/jenia/poky-jethro/meta-intel/meta-tlk \
  /home/jenia/poky-jethro/meta-sxbti \
  "
BBLAYERS_NON_REMOVABLE ?= " \
  /home/jenia/poky-jethro/meta \
  /home/jenia/poky-jethro/meta-yocto \
  "
```
